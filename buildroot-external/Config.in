## buildroot-external/Config.in
```kconfig
source "$BR2_EXTERNAL_LUCKFOX_86PANEL_PATH/package/calaos-remote-ui/Config.in"
source "$BR2_EXTERNAL_LUCKFOX_86PANEL_PATH/package/aic8800dc-wifi/Config.in"
```

## buildroot-external/configs/luckfox_pico_86panel_w_defconfig
```kconfig
BR2_arm=y
BR2_cortex_a7=y
BR2_ARM_FPU_NEON_VFPV4=y
BR2_ARM_INSTRUCTIONS_THUMB2=y
BR2_TOOLCHAIN_EXTERNAL=y
BR2_TOOLCHAIN_EXTERNAL_CUSTOM=y
BR2_TOOLCHAIN_EXTERNAL_DOWNLOAD=y
BR2_TOOLCHAIN_EXTERNAL_URL="https://toolchains.bootlin.com/downloads/releases/toolchains/armv7-eabihf/tarballs/armv7-eabihf--glibc--stable-2023.11-1.tar.bz2"
BR2_TOOLCHAIN_EXTERNAL_CUSTOM_PREFIX="arm-buildroot-linux-gnueabihf"
BR2_TOOLCHAIN_EXTERNAL_GCC_12=y
BR2_TOOLCHAIN_EXTERNAL_HEADERS_4_14=y
BR2_TOOLCHAIN_EXTERNAL_CUSTOM_GLIBC=y
BR2_TOOLCHAIN_EXTERNAL_CXX=y
BR2_TOOLCHAIN_EXTERNAL_HAS_SSP=y
BR2_TOOLCHAIN_EXTERNAL_HAS_SSP_STRONG=y
BR2_TOOLCHAIN_EXTERNAL_FORTRAN=y
BR2_TOOLCHAIN_EXTERNAL_OPENMP=y
# BR2_TOOLCHAIN_EXTERNAL_INET_RPC is not set
BR2_OPTIMIZE_3=y
BR2_TARGET_GENERIC_HOSTNAME="calaos_remote_ui"
BR2_TARGET_GENERIC_ISSUE="Welcome to Calaos remote UI"
BR2_ROOTFS_DEVICE_CREATION_DYNAMIC_EUDEV=y
BR2_TARGET_GENERIC_ROOT_PASSWD="calaos"
BR2_SYSTEM_DEFAULT_PATH="/bin:/sbin:/usr/bin:/usr/sbin:/usr/local/bin"
BR2_SYSTEM_ENABLE_NLS=y
BR2_ROOTFS_OVERLAY="$(BR2_EXTERNAL_LUCKFOX_86PANEL_PATH)/board/luckfox/pico-86panel-w/rootfs-overlay"
BR2_ROOTFS_POST_IMAGE_SCRIPT="$(BR2_EXTERNAL_LUCKFOX_86PANEL_PATH)/board/luckfox/pico-86panel-w/post-image.sh"
BR2_LINUX_KERNEL=y
BR2_LINUX_KERNEL_CUSTOM_GIT=y
BR2_LINUX_KERNEL_CUSTOM_REPO_URL="https://github.com/calaos/luckfox-kernel"
BR2_LINUX_KERNEL_CUSTOM_REPO_VERSION="e502a060e"
BR2_LINUX_KERNEL_DEFCONFIG="luckfox_rv1106_linux"
BR2_LINUX_KERNEL_CONFIG_FRAGMENT_FILES="$(BR2_EXTERNAL_LUCKFOX_86PANEL_PATH)/board/luckfox/pico-86panel-w/kernel-rv1106-bt.config $(BR2_EXTERNAL_LUCKFOX_86PANEL_PATH)/board/luckfox/pico-86panel-w/kernel-rv1106-gt911-module.config $(BR2_EXTERNAL_LUCKFOX_86PANEL_PATH)/board/luckfox/pico-86panel-w/kernel-rv1106-cma-active.config $(BR2_EXTERNAL_LUCKFOX_86PANEL_PATH)/board/luckfox/pico-86panel-w/kernel-rv1106-wifi.config"
BR2_LINUX_KERNEL_IMAGE_TARGET_CUSTOM=y
BR2_LINUX_KERNEL_IMAGE_TARGET_NAME="zImage"
BR2_LINUX_KERNEL_DTS_SUPPORT=y
BR2_LINUX_KERNEL_INTREE_DTS_NAME="rv1106g-luckfox-pico-86panel-w"
BR2_LINUX_KERNEL_NEEDS_HOST_OPENSSL=y
BR2_PACKAGE_GETTEXT=y
BR2_PACKAGE_ROCKCHIP_RKBIN=y
BR2_TARGET_ROOTFS_EXT2=y
BR2_TARGET_ROOTFS_EXT2_4=y
BR2_TARGET_ROOTFS_EXT2_SIZE="512M"
BR2_TARGET_UBOOT=y
BR2_TARGET_UBOOT_BUILD_SYSTEM_KCONFIG=y
BR2_TARGET_UBOOT_CUSTOM_GIT=y
BR2_TARGET_UBOOT_CUSTOM_REPO_URL="https://github.com/calaos/luckfox-uboot"
BR2_TARGET_UBOOT_CUSTOM_REPO_VERSION="2017.09-sdk-994243753"
BR2_TARGET_UBOOT_BOARD_DEFCONFIG="luckfox_rv1106_uboot"
BR2_TARGET_UBOOT_CONFIG_FRAGMENT_FILES="$(BR2_EXTERNAL_LUCKFOX_86PANEL_PATH)/board/luckfox/pico-86panel-w/uboot-rk-emmc.config $(BR2_EXTERNAL_LUCKFOX_86PANEL_PATH)/board/luckfox/pico-86panel-w/uboot-rv1106-luckfox-rgb-reset.config $(BR2_EXTERNAL_LUCKFOX_86PANEL_PATH)/board/luckfox/pico-86panel-w/uboot-adc-key.config"
BR2_TARGET_UBOOT_NEEDS_DTC=y
BR2_PACKAGE_HOST_UBOOT_TOOLS=y
BR2_PACKAGE_DHCPCD=y
BR2_PACKAGE_DROPBEAR=y
BR2_PACKAGE_ETHTOOL=y
BR2_PACKAGE_IFUPDOWN_SCRIPTS=y
BR2_PACKAGE_IW=y
BR2_PACKAGE_WIRELESS_TOOLS=y
BR2_PACKAGE_WPA_SUPPLICANT=y
BR2_PACKAGE_WPA_SUPPLICANT_NL80211=y
BR2_PACKAGE_WPA_SUPPLICANT_CLI=y
BR2_PACKAGE_WPA_SUPPLICANT_PASSPHRASE=y
BR2_PACKAGE_AIC8800DC_WIFI=y
BR2_PACKAGE_CALAOS_REMOTE_UI=y
```

## buildroot-external/package/aic8800dc-wifi/Config.in
```kconfig
config BR2_PACKAGE_AIC8800DC_WIFI
	bool "aic8800dc-wifi"
	depends on BR2_LINUX_KERNEL
	help
	  AIC8800DC WiFi + Bluetooth SDIO driver for the
	  Luckfox Pico 86Panel W board.

	  Builds three kernel modules (aic8800_bsp, aic8800_fdrv,
	  aic8800_btlpm) and installs the firmware blobs to
	  /lib/firmware/aic8800dc/.
```

## buildroot-external/package/calaos-remote-ui/Config.in
```kconfig
config BR2_PACKAGE_CALAOS_REMOTE_UI
	bool "calaos-remote-ui"
	depends on BR2_INSTALL_LIBSTDCPP
	depends on BR2_TOOLCHAIN_HAS_THREADS
	select BR2_PACKAGE_MBEDTLS
	select BR2_PACKAGE_LIBDRM
	select BR2_PACKAGE_LIBEVDEV
	help
	  Calaos Remote UI — LVGL smart-home control panel for Luckfox Pico 86Panel.
```
